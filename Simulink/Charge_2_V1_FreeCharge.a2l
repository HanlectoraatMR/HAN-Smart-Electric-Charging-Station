/******************************************************************************
* ASAP2 file: Charge_2_V1_FreeCharge.a2l
* Academic License - for use in teaching, academic research, and meeting
* course requirements at degree granting institutions only. Not for
* government, commercial, or other organizational use.
* Code generation for model "Charge_2_V1_FreeCharge".
* Model version : 1.716
* Simulink Coder version : 9.0 (R2018b) 24-May-2018
* C source code generated on : Mon Jun 3 17:24:36 2019
* Target selection: ert.tlc
* Embedded hardware selection: Generic->32-bit Embedded Processor
* Code generation objectives: Unspecified
* Validation result: Not run
* (add additional file header information here)
******************************************************************************/ ASAP2_VERSION 1 31
/* Version 1.31 */
/begin PROJECT ProjectName "Charge_2_V1_FreeCharge_softwareID_v1_030619_172414"
/begin HEADER "Header Comments go here" /end HEADER
/begin MODULE ModuleName "Module Comment Goes Here"
/begin MOD_PAR "MOD PAR Comment Goes Here" /end MOD_PAR
/begin MOD_COMMON "Mod Common Comment Here" BYTE_ORDER MSB_LAST /end MOD_COMMON
/begin RECORD_LAYOUT Scalar_BOOLEAN FNC_VALUES 1 UBYTE COLUMN_DIR DIRECT /end RECORD_LAYOUT
/begin RECORD_LAYOUT Scalar_UBYTE FNC_VALUES 1 UBYTE COLUMN_DIR DIRECT /end RECORD_LAYOUT
/begin RECORD_LAYOUT Scalar_BYTE FNC_VALUES 1 SBYTE COLUMN_DIR DIRECT /end RECORD_LAYOUT
/begin RECORD_LAYOUT Scalar_UWORD FNC_VALUES 1 UWORD COLUMN_DIR DIRECT /end RECORD_LAYOUT
/begin RECORD_LAYOUT Scalar_SWORD FNC_VALUES 1 SWORD COLUMN_DIR DIRECT /end RECORD_LAYOUT
/begin RECORD_LAYOUT Scalar_ULONG FNC_VALUES 1 ULONG COLUMN_DIR DIRECT /end RECORD_LAYOUT
/begin RECORD_LAYOUT Scalar_LONG FNC_VALUES 1 SLONG COLUMN_DIR DIRECT /end RECORD_LAYOUT
/begin RECORD_LAYOUT Scalar_FLOAT32_IEEE FNC_VALUES 1 FLOAT32_IEEE COLUMN_DIR DIRECT /end RECORD_LAYOUT
/begin RECORD_LAYOUT Scalar_FLOAT64_IEEE FNC_VALUES 1 FLOAT64_IEEE COLUMN_DIR DIRECT /end RECORD_LAYOUT
/begin RECORD_LAYOUT Lookup1D_BYTE FNC_VALUES 1 SBYTE COLUMN_DIR DIRECT /end RECORD_LAYOUT
/begin RECORD_LAYOUT Lookup1D_X_BYTE AXIS_PTS_X 1 SBYTE INDEX_INCR DIRECT /end RECORD_LAYOUT
/begin RECORD_LAYOUT Lookup1D_UBYTE FNC_VALUES 1 UBYTE COLUMN_DIR DIRECT /end RECORD_LAYOUT
/begin RECORD_LAYOUT Lookup1D_X_UBYTE AXIS_PTS_X 1 UBYTE INDEX_INCR DIRECT /end RECORD_LAYOUT
/begin RECORD_LAYOUT Lookup1D_UWORD FNC_VALUES 1 UWORD COLUMN_DIR DIRECT /end RECORD_LAYOUT
/begin RECORD_LAYOUT Lookup1D_X_UWORD AXIS_PTS_X 1 UWORD INDEX_INCR DIRECT /end RECORD_LAYOUT
/begin RECORD_LAYOUT Lookup1D_WORD FNC_VALUES 1 SWORD COLUMN_DIR DIRECT /end RECORD_LAYOUT
/begin RECORD_LAYOUT Lookup1D_X_WORD AXIS_PTS_X 1 SWORD INDEX_INCR DIRECT /end RECORD_LAYOUT
/begin RECORD_LAYOUT Lookup1D_ULONG FNC_VALUES 1 ULONG COLUMN_DIR DIRECT /end RECORD_LAYOUT
/begin RECORD_LAYOUT Lookup1D_X_ULONG AXIS_PTS_X 1 ULONG INDEX_INCR DIRECT /end RECORD_LAYOUT
/begin RECORD_LAYOUT Lookup1D_SLONG FNC_VALUES 1 SLONG COLUMN_DIR DIRECT /end RECORD_LAYOUT
/begin RECORD_LAYOUT Lookup1D_X_LONG AXIS_PTS_X 1 SLONG INDEX_INCR DIRECT /end RECORD_LAYOUT
/begin RECORD_LAYOUT Lookup1D_FLOAT32_IEEE FNC_VALUES 1 FLOAT32_IEEE COLUMN_DIR DIRECT /end RECORD_LAYOUT
/begin RECORD_LAYOUT Lookup1D_X_FLOAT32_IEEE AXIS_PTS_X 1 FLOAT32_IEEE INDEX_INCR DIRECT /end RECORD_LAYOUT
/begin RECORD_LAYOUT Lookup1D_FLOAT64_IEEE FNC_VALUES 1 FLOAT64_IEEE COLUMN_DIR DIRECT /end RECORD_LAYOUT
/begin RECORD_LAYOUT Lookup1D_X_FLOAT64_IEEE AXIS_PTS_X 1 FLOAT64_IEEE INDEX_INCR DIRECT /end RECORD_LAYOUT
/begin RECORD_LAYOUT Lookup2D_UBYTE FNC_VALUES 1 UBYTE COLUMN_DIR DIRECT /end RECORD_LAYOUT
/begin RECORD_LAYOUT Lookup2D_X_UBYTE AXIS_PTS_X 1 UBYTE INDEX_INCR DIRECT /end RECORD_LAYOUT
/begin RECORD_LAYOUT Lookup2D_BYTE FNC_VALUES 1 SBYTE COLUMN_DIR DIRECT /end RECORD_LAYOUT
/begin RECORD_LAYOUT Lookup2D_X_BYTE AXIS_PTS_X 1 SBYTE INDEX_INCR DIRECT /end RECORD_LAYOUT
/begin RECORD_LAYOUT Lookup2D_UWORD FNC_VALUES 1 UWORD COLUMN_DIR DIRECT /end RECORD_LAYOUT
/begin RECORD_LAYOUT Lookup2D_X_UWORD AXIS_PTS_X 1 UWORD INDEX_INCR DIRECT /end RECORD_LAYOUT
/begin RECORD_LAYOUT Lookup2D_WORD FNC_VALUES 1 SWORD COLUMN_DIR DIRECT /end RECORD_LAYOUT
/begin RECORD_LAYOUT Lookup2D_X_WORD AXIS_PTS_X 1 SWORD INDEX_INCR DIRECT /end RECORD_LAYOUT
/begin RECORD_LAYOUT Lookup2D_ULONG FNC_VALUES 1 ULONG COLUMN_DIR DIRECT /end RECORD_LAYOUT
/begin RECORD_LAYOUT Lookup2D_X_ULONG AXIS_PTS_X 1 ULONG INDEX_INCR DIRECT /end RECORD_LAYOUT
/begin RECORD_LAYOUT Lookup2D_LONG FNC_VALUES 1 SLONG COLUMN_DIR DIRECT /end RECORD_LAYOUT
/begin RECORD_LAYOUT Lookup2D_X_LONG AXIS_PTS_X 1 SLONG INDEX_INCR DIRECT /end RECORD_LAYOUT
/begin RECORD_LAYOUT Lookup2D_FLOAT32_IEEE FNC_VALUES 1 FLOAT32_IEEE COLUMN_DIR DIRECT /end RECORD_LAYOUT
/begin RECORD_LAYOUT Lookup2D_X_FLOAT32_IEEE AXIS_PTS_X 1 FLOAT32_IEEE INDEX_INCR DIRECT /end RECORD_LAYOUT
/begin RECORD_LAYOUT Lookup2D_FLOAT64_IEEE FNC_VALUES 1 FLOAT64_IEEE COLUMN_DIR DIRECT /end RECORD_LAYOUT
/begin RECORD_LAYOUT Lookup2D_X_FLOAT64_IEEE AXIS_PTS_X 1 FLOAT64_IEEE INDEX_INCR DIRECT /end RECORD_LAYOUT
/begin CHARACTERISTIC SeconCar_ThreePhase "" VALUE 0x0000 Scalar_FLOAT64_IEEE 0 Charge_2_V1_FreeCharge_CM_double -1.7E+308 1.7E+308 /end CHARACTERISTIC
/begin CHARACTERISTIC V_Current_five "" VALUE 0x0000 Scalar_FLOAT64_IEEE 0 Charge_2_V1_FreeCharge_CM_double -1.7E+308 1.7E+308 /end CHARACTERISTIC
/begin CHARACTERISTIC V_Current_four "" VALUE 0x0000 Scalar_FLOAT64_IEEE 0 Charge_2_V1_FreeCharge_CM_double -1.7E+308 1.7E+308 /end CHARACTERISTIC
/begin CHARACTERISTIC V_Current_one "" VALUE 0x0000 Scalar_FLOAT64_IEEE 0 Charge_2_V1_FreeCharge_CM_double -1.7E+308 1.7E+308 /end CHARACTERISTIC
/begin CHARACTERISTIC V_Current_six "" VALUE 0x0000 Scalar_FLOAT64_IEEE 0 Charge_2_V1_FreeCharge_CM_double -1.7E+308 1.7E+308 /end CHARACTERISTIC
/begin CHARACTERISTIC V_Current_three "" VALUE 0x0000 Scalar_FLOAT64_IEEE 0 Charge_2_V1_FreeCharge_CM_double -1.7E+308 1.7E+308 /end CHARACTERISTIC
/begin CHARACTERISTIC V_Current_two "" VALUE 0x0000 Scalar_FLOAT64_IEEE 0 Charge_2_V1_FreeCharge_CM_double -1.7E+308 1.7E+308 /end CHARACTERISTIC
/begin CHARACTERISTIC V_MaxPliot "" VALUE 0x0000 Scalar_FLOAT64_IEEE 0 Charge_2_V1_FreeCharge_CM_double -1.7E+308 1.7E+308 /end CHARACTERISTIC
/begin CHARACTERISTIC V_MinPliot "" VALUE 0x0000 Scalar_FLOAT64_IEEE 0 Charge_2_V1_FreeCharge_CM_double -1.7E+308 1.7E+308 /end CHARACTERISTIC
/begin CHARACTERISTIC Control_Mode_In "" VALUE 20000018 Scalar_FLOAT32_IEEE 0 Charge_2_V1_FreeCharge_CM_single -3.4E+38 3.4E+38 /end CHARACTERISTIC
/begin CHARACTERISTIC CurrentSP "" VALUE 2000000c Scalar_FLOAT32_IEEE 0 Charge_2_V1_FreeCharge_CM_single -3.4E+38 3.4E+38 /end CHARACTERISTIC
/begin CHARACTERISTIC Frequency_High_Point "" VALUE 20000034 Scalar_FLOAT32_IEEE 0 Charge_2_V1_FreeCharge_CM_single -3.4E+38 3.4E+38 /end CHARACTERISTIC
/begin CHARACTERISTIC Frequency_Low_Point "" VALUE 20000040 Scalar_FLOAT32_IEEE 0 Charge_2_V1_FreeCharge_CM_single -3.4E+38 3.4E+38 /end CHARACTERISTIC
/begin CHARACTERISTIC Frequency_Mid_high "" VALUE 20000038 Scalar_FLOAT32_IEEE 0 Charge_2_V1_FreeCharge_CM_single -3.4E+38 3.4E+38 /end CHARACTERISTIC
/begin CHARACTERISTIC Frequency_Mid_low "" VALUE 2000002c Scalar_FLOAT32_IEEE 0 Charge_2_V1_FreeCharge_CM_single -3.4E+38 3.4E+38 /end CHARACTERISTIC
/begin CHARACTERISTIC HVol_High_Point "" VALUE 2000004c Scalar_FLOAT32_IEEE 0 Charge_2_V1_FreeCharge_CM_single -3.4E+38 3.4E+38 /end CHARACTERISTIC
/begin CHARACTERISTIC HVol_Low_Point "" VALUE 2000003c Scalar_FLOAT32_IEEE 0 Charge_2_V1_FreeCharge_CM_single -3.4E+38 3.4E+38 /end CHARACTERISTIC
/begin CHARACTERISTIC HVol_Mid_high "" VALUE 20000048 Scalar_FLOAT32_IEEE 0 Charge_2_V1_FreeCharge_CM_single -3.4E+38 3.4E+38 /end CHARACTERISTIC
/begin CHARACTERISTIC HVol_Mid_low "" VALUE 20000008 Scalar_FLOAT32_IEEE 0 Charge_2_V1_FreeCharge_CM_single -3.4E+38 3.4E+38 /end CHARACTERISTIC
/begin CHARACTERISTIC HVoltage_Factor "" VALUE 20000024 Scalar_FLOAT32_IEEE 0 Charge_2_V1_FreeCharge_CM_single -3.4E+38 3.4E+38 /end CHARACTERISTIC
/begin CHARACTERISTIC V_Frequency "" VALUE 2000001c Scalar_FLOAT32_IEEE 0 Charge_2_V1_FreeCharge_CM_single -3.4E+38 3.4E+38 /end CHARACTERISTIC
/begin CHARACTERISTIC Vol_High_Point "" VALUE 20000044 Scalar_FLOAT32_IEEE 0 Charge_2_V1_FreeCharge_CM_single -3.4E+38 3.4E+38 /end CHARACTERISTIC
/begin CHARACTERISTIC Vol_Low_Point "" VALUE 20000004 Scalar_FLOAT32_IEEE 0 Charge_2_V1_FreeCharge_CM_single -3.4E+38 3.4E+38 /end CHARACTERISTIC
/begin CHARACTERISTIC Vol_Mid_high "" VALUE 20000028 Scalar_FLOAT32_IEEE 0 Charge_2_V1_FreeCharge_CM_single -3.4E+38 3.4E+38 /end CHARACTERISTIC
/begin CHARACTERISTIC Vol_Mid_low "" VALUE 20000014 Scalar_FLOAT32_IEEE 0 Charge_2_V1_FreeCharge_CM_single -3.4E+38 3.4E+38 /end CHARACTERISTIC
/begin CHARACTERISTIC Voltage_Factor "" VALUE 20000030 Scalar_FLOAT32_IEEE 0 Charge_2_V1_FreeCharge_CM_single -3.4E+38 3.4E+38 /end CHARACTERISTIC
/begin CHARACTERISTIC Voltage_Mode_Test "" VALUE 20000020 Scalar_FLOAT32_IEEE 0 Charge_2_V1_FreeCharge_CM_single -3.4E+38 3.4E+38 /end CHARACTERISTIC
/begin CHARACTERISTIC Car1__Authorize "" VALUE 0x0000 Scalar_BOOLEAN 0 Charge_2_V1_FreeCharge_CM_boolean 0 1 /end CHARACTERISTIC
/begin CHARACTERISTIC Car2_Authorize "" VALUE 0x0000 Scalar_BOOLEAN 0 Charge_2_V1_FreeCharge_CM_boolean 0 1 /end CHARACTERISTIC
/begin CHARACTERISTIC Free_Charge "" VALUE 20000010 Scalar_BOOLEAN 0 Charge_2_V1_FreeCharge_CM_boolean 0 1 /end CHARACTERISTIC
/begin MEASUREMENT Car_type_charge1 "" FLOAT64_IEEE Charge_2_V1_FreeCharge_CM_double 0 0 -1.7E+308 1.7E+308 ECU_ADDRESS 2000c7d0 /end MEASUREMENT
/begin MEASUREMENT Car_type_charge2 "" FLOAT64_IEEE Charge_2_V1_FreeCharge_CM_double 0 0 -1.7E+308 1.7E+308 ECU_ADDRESS 2000ca28 /end MEASUREMENT
/begin MEASUREMENT SI_FreeHeap "" ULONG Charge_2_V1_FreeCharge_CM_uint32 0 0 0 4294967295 ECU_ADDRESS 2000c800 /end MEASUREMENT
/begin MEASUREMENT SI_FreeStack "" ULONG Charge_2_V1_FreeCharge_CM_uint32 0 0 0 4294967295 ECU_ADDRESS 2000c900 /end MEASUREMENT
/begin MEASUREMENT Max_Pilot "" FLOAT32_IEEE Charge_2_V1_FreeCharge_CM_single 0 0 -3.4E+38 3.4E+38 ECU_ADDRESS 2000ca40 /end MEASUREMENT
/begin MEASUREMENT Min_Pilot "" FLOAT32_IEEE Charge_2_V1_FreeCharge_CM_single 0 0 -3.4E+38 3.4E+38 ECU_ADDRESS 2000c7dc /end MEASUREMENT
/begin MEASUREMENT Current_phase1 "" FLOAT32_IEEE Charge_2_V1_FreeCharge_CM_single 0 0 -3.4E+38 3.4E+38 ECU_ADDRESS 2000c54c /end MEASUREMENT
/begin MEASUREMENT Current_phase2 "" FLOAT32_IEEE Charge_2_V1_FreeCharge_CM_single 0 0 -3.4E+38 3.4E+38 ECU_ADDRESS 2000ca0c /end MEASUREMENT
/begin MEASUREMENT Current_phase3 "" FLOAT32_IEEE Charge_2_V1_FreeCharge_CM_single 0 0 -3.4E+38 3.4E+38 ECU_ADDRESS 2000c7e0 /end MEASUREMENT
/begin MEASUREMENT Current_phase4 "" FLOAT32_IEEE Charge_2_V1_FreeCharge_CM_single 0 0 -3.4E+38 3.4E+38 ECU_ADDRESS 2000ca3c /end MEASUREMENT
/begin MEASUREMENT Current_phase5 "" FLOAT32_IEEE Charge_2_V1_FreeCharge_CM_single 0 0 -3.4E+38 3.4E+38 ECU_ADDRESS 2000ca20 /end MEASUREMENT
/begin MEASUREMENT Current_phase6 "" FLOAT32_IEEE Charge_2_V1_FreeCharge_CM_single 0 0 -3.4E+38 3.4E+38 ECU_ADDRESS 2000c7bc /end MEASUREMENT
/begin MEASUREMENT Current_Limit "" FLOAT32_IEEE Charge_2_V1_FreeCharge_CM_single 0 0 -3.4E+38 3.4E+38 ECU_ADDRESS 2000ca04 /end MEASUREMENT
/begin MEASUREMENT Mode "" FLOAT32_IEEE Charge_2_V1_FreeCharge_CM_single 0 0 -3.4E+38 3.4E+38 ECU_ADDRESS 2000c7f8 /end MEASUREMENT
/begin MEASUREMENT SP1_P "" FLOAT32_IEEE Charge_2_V1_FreeCharge_CM_single 0 0 -3.4E+38 3.4E+38 ECU_ADDRESS 2000c8f0 /end MEASUREMENT
/begin MEASUREMENT V_Frequency_SP "" FLOAT32_IEEE Charge_2_V1_FreeCharge_CM_single 0 0 -3.4E+38 3.4E+38 ECU_ADDRESS 2000ca14 /end MEASUREMENT
/begin MEASUREMENT Initial_Current_1 "" FLOAT32_IEEE Charge_2_V1_FreeCharge_CM_single 0 0 -3.4E+38 3.4E+38 ECU_ADDRESS 2000c90c /end MEASUREMENT
/begin MEASUREMENT Current_SP_Car1 "" FLOAT32_IEEE Charge_2_V1_FreeCharge_CM_single 0 0 -3.4E+38 3.4E+38 ECU_ADDRESS 2000ca10 /end MEASUREMENT
/begin MEASUREMENT Max_out "" FLOAT32_IEEE Charge_2_V1_FreeCharge_CM_single 0 0 -3.4E+38 3.4E+38 ECU_ADDRESS 2000c52c /end MEASUREMENT
/begin MEASUREMENT Maxpilotcar2 "" FLOAT32_IEEE Charge_2_V1_FreeCharge_CM_single 0 0 -3.4E+38 3.4E+38 ECU_ADDRESS 2000c528 /end MEASUREMENT
/begin MEASUREMENT Minpilotcar2 "" FLOAT32_IEEE Charge_2_V1_FreeCharge_CM_single 0 0 -3.4E+38 3.4E+38 ECU_ADDRESS 2000c8f4 /end MEASUREMENT
/begin MEASUREMENT Control_Mode_Out "" FLOAT32_IEEE Charge_2_V1_FreeCharge_CM_single 0 0 -3.4E+38 3.4E+38 ECU_ADDRESS 2000ca00 /end MEASUREMENT
/begin MEASUREMENT SP2_P "" FLOAT32_IEEE Charge_2_V1_FreeCharge_CM_single 0 0 -3.4E+38 3.4E+38 ECU_ADDRESS 2000c804 /end MEASUREMENT
/begin MEASUREMENT voltage_de "" FLOAT32_IEEE Charge_2_V1_FreeCharge_CM_single 0 0 -3.4E+38 3.4E+38 ECU_ADDRESS 2000c7f4 /end MEASUREMENT
/begin MEASUREMENT Initial_current_2 "" FLOAT32_IEEE Charge_2_V1_FreeCharge_CM_single 0 0 -3.4E+38 3.4E+38 ECU_ADDRESS 2000c8e4 /end MEASUREMENT
/begin MEASUREMENT Current_SP_car2 "" FLOAT32_IEEE Charge_2_V1_FreeCharge_CM_single 0 0 -3.4E+38 3.4E+38 ECU_ADDRESS 2000c53c /end MEASUREMENT
/begin MEASUREMENT Power_SP "" FLOAT32_IEEE Charge_2_V1_FreeCharge_CM_single 0 0 -3.4E+38 3.4E+38 ECU_ADDRESS 2000c8f8 /end MEASUREMENT
/begin MEASUREMENT Frequency "" FLOAT32_IEEE Charge_2_V1_FreeCharge_CM_single 0 0 -3.4E+38 3.4E+38 ECU_ADDRESS 2000ca08 /end MEASUREMENT
/begin MEASUREMENT Voltage_phase1 "" FLOAT32_IEEE Charge_2_V1_FreeCharge_CM_single 0 0 -3.4E+38 3.4E+38 ECU_ADDRESS 2000ca1c /end MEASUREMENT
/begin MEASUREMENT Voltage_phase2 "" FLOAT32_IEEE Charge_2_V1_FreeCharge_CM_single 0 0 -3.4E+38 3.4E+38 ECU_ADDRESS 2000c8dc /end MEASUREMENT
/begin MEASUREMENT Voltage_phase3 "" FLOAT32_IEEE Charge_2_V1_FreeCharge_CM_single 0 0 -3.4E+38 3.4E+38 ECU_ADDRESS 2000c7e4 /end MEASUREMENT
/begin MEASUREMENT Voltage_phase4 "" FLOAT32_IEEE Charge_2_V1_FreeCharge_CM_single 0 0 -3.4E+38 3.4E+38 ECU_ADDRESS 2000c908 /end MEASUREMENT
/begin MEASUREMENT Voltage_phase5 "" FLOAT32_IEEE Charge_2_V1_FreeCharge_CM_single 0 0 -3.4E+38 3.4E+38 ECU_ADDRESS 2000c7ec /end MEASUREMENT
/begin MEASUREMENT Voltage_phase6 "" FLOAT32_IEEE Charge_2_V1_FreeCharge_CM_single 0 0 -3.4E+38 3.4E+38 ECU_ADDRESS 2000c530 /end MEASUREMENT
/begin MEASUREMENT VoltageControl3phaseout "" FLOAT32_IEEE Charge_2_V1_FreeCharge_CM_single 0 0 -3.4E+38 3.4E+38 ECU_ADDRESS 2000ca34 /end MEASUREMENT
/begin MEASUREMENT VoltageControl1phaseout "" FLOAT32_IEEE Charge_2_V1_FreeCharge_CM_single 0 0 -3.4E+38 3.4E+38 ECU_ADDRESS 2000c8e8 /end MEASUREMENT
/begin MEASUREMENT Current_input_car2 "" FLOAT32_IEEE Charge_2_V1_FreeCharge_CM_single 0 0 -3.4E+38 3.4E+38 ECU_ADDRESS 2000c7c0 /end MEASUREMENT
/begin MEASUREMENT Current_Input_car1 "" FLOAT32_IEEE Charge_2_V1_FreeCharge_CM_single 0 0 -3.4E+38 3.4E+38 ECU_ADDRESS 2000c534 /end MEASUREMENT
/begin MEASUREMENT PilotCar1Raw "" UWORD Charge_2_V1_FreeCharge_CM_uint16 0 0 0 65535 ECU_ADDRESS 2000c538 /end MEASUREMENT
/begin MEASUREMENT PilotCar2Raw "" UWORD Charge_2_V1_FreeCharge_CM_uint16 0 0 0 65535 ECU_ADDRESS 2000c8d8 /end MEASUREMENT
/begin MEASUREMENT Status "" UWORD Charge_2_V1_FreeCharge_CM_uint16 0 0 0 65535 ECU_ADDRESS 2000c7ca /end MEASUREMENT
/begin MEASUREMENT SI_CPUload "" UBYTE Charge_2_V1_FreeCharge_CM_uint8 0 0 0 255 ECU_ADDRESS 2000ca19 /end MEASUREMENT
/begin MEASUREMENT End_SP1 "" UBYTE Charge_2_V1_FreeCharge_CM_uint8 0 0 0 255 ECU_ADDRESS 2000ca1b /end MEASUREMENT
/begin MEASUREMENT Setpoint1 "" UBYTE Charge_2_V1_FreeCharge_CM_uint8 0 0 0 255 ECU_ADDRESS 2000c7c4 /end MEASUREMENT
/begin MEASUREMENT SP_ID "" UBYTE Charge_2_V1_FreeCharge_CM_uint8 0 0 0 255 ECU_ADDRESS 2000c904 /end MEASUREMENT
/begin MEASUREMENT Setpoin_check1 "" UBYTE Charge_2_V1_FreeCharge_CM_uint8 0 0 0 255 ECU_ADDRESS 2000c7c7 /end MEASUREMENT
/begin MEASUREMENT Sent_to_MCU "" UBYTE Charge_2_V1_FreeCharge_CM_uint8 0 0 0 255 ECU_ADDRESS 2000c7f1 /end MEASUREMENT
/begin MEASUREMENT Check_ID_Voltage2 "" UBYTE Charge_2_V1_FreeCharge_CM_uint8 0 0 0 255 ECU_ADDRESS 2000c7f2 /end MEASUREMENT
/begin MEASUREMENT Check_ID_Voltage1 "" UBYTE Charge_2_V1_FreeCharge_CM_uint8 0 0 0 255 ECU_ADDRESS 2000c7d8 /end MEASUREMENT
/begin MEASUREMENT Check_Fre_ID "" UBYTE Charge_2_V1_FreeCharge_CM_uint8 0 0 0 255 ECU_ADDRESS 2000c808 /end MEASUREMENT
/begin MEASUREMENT Check_ID_Current1 "" UBYTE Charge_2_V1_FreeCharge_CM_uint8 0 0 0 255 ECU_ADDRESS 2000c7d9 /end MEASUREMENT
/begin MEASUREMENT Check_ID2_Current2 "" UBYTE Charge_2_V1_FreeCharge_CM_uint8 0 0 0 255 ECU_ADDRESS 2000c8d6 /end MEASUREMENT
/begin MEASUREMENT State_Test "" SBYTE Charge_2_V1_FreeCharge_CM_int8 0 0 -128 127 ECU_ADDRESS 2000ca44 /end MEASUREMENT
/begin MEASUREMENT State_Test_1 "" SBYTE Charge_2_V1_FreeCharge_CM_int8 0 0 -128 127 ECU_ADDRESS 2000ca38 /end MEASUREMENT
/begin MEASUREMENT State_Test_2 "" SBYTE Charge_2_V1_FreeCharge_CM_int8 0 0 -128 127 ECU_ADDRESS 2000c7f0 /end MEASUREMENT
/begin MEASUREMENT Current_Limit_state "" SBYTE Charge_2_V1_FreeCharge_CM_int8 0 0 -128 127 ECU_ADDRESS 2000ca18 /end MEASUREMENT
/begin MEASUREMENT Car2State "" SBYTE Charge_2_V1_FreeCharge_CM_int8 0 0 -128 127 ECU_ADDRESS 2000ca39 /end MEASUREMENT
/begin MEASUREMENT Car1State "" SBYTE Charge_2_V1_FreeCharge_CM_int8 0 0 -128 127 ECU_ADDRESS 2000c7fc /end MEASUREMENT
/begin MEASUREMENT Enable_card2 "" UBYTE Charge_2_V1_FreeCharge_CM_boolean 0 0 0 1 ECU_ADDRESS 2000ca30 /end MEASUREMENT
/begin MEASUREMENT Enable_card1 "" UBYTE Charge_2_V1_FreeCharge_CM_boolean 0 0 0 1 ECU_ADDRESS 2000c8da /end MEASUREMENT
/begin MEASUREMENT RFID_Read "" UBYTE Charge_2_V1_FreeCharge_CM_boolean 0 0 0 1 ECU_ADDRESS 2000ca1a /end MEASUREMENT
/begin MEASUREMENT SwitchCar1 "" UBYTE Charge_2_V1_FreeCharge_CM_boolean 0 0 0 1 ECU_ADDRESS 2000c8e0 /end MEASUREMENT
/begin MEASUREMENT LockCar1off "" UBYTE Charge_2_V1_FreeCharge_CM_boolean 0 0 0 1 ECU_ADDRESS 2000c7c5 /end MEASUREMENT
/begin MEASUREMENT SwitchCar2 "" UBYTE Charge_2_V1_FreeCharge_CM_boolean 0 0 0 1 ECU_ADDRESS 2000c7b8 /end MEASUREMENT
/begin MEASUREMENT LockCar2off "" UBYTE Charge_2_V1_FreeCharge_CM_boolean 0 0 0 1 ECU_ADDRESS 2000c7c6 /end MEASUREMENT
/begin MEASUREMENT counter "" UBYTE Charge_2_V1_FreeCharge_CM_boolean 0 0 0 1 ECU_ADDRESS 2000c8ec /end MEASUREMENT
/begin MEASUREMENT enable "" UBYTE Charge_2_V1_FreeCharge_CM_boolean 0 0 0 1 ECU_ADDRESS 2000c7e8 /end MEASUREMENT
/begin MEASUREMENT LockCar2On "" UBYTE Charge_2_V1_FreeCharge_CM_boolean 0 0 0 1 ECU_ADDRESS 2000c7c8 /end MEASUREMENT
/begin MEASUREMENT LockCar1On "" UBYTE Charge_2_V1_FreeCharge_CM_boolean 0 0 0 1 ECU_ADDRESS 2000c8fc /end MEASUREMENT
/begin COMPU_METHOD Charge_2_V1_FreeCharge_CM_double "Q = V" RAT_FUNC "%15.10" "" COEFFS 0 1 0 0 0 1 /end COMPU_METHOD
/begin COMPU_METHOD Charge_2_V1_FreeCharge_CM_single "Q = V" RAT_FUNC "%8.6" "" COEFFS 0 1 0 0 0 1 /end COMPU_METHOD
/begin COMPU_METHOD Charge_2_V1_FreeCharge_CM_boolean "Q = V" RAT_FUNC "%1.0" "" COEFFS 0 1 0 0 0 1 /end COMPU_METHOD
/begin COMPU_METHOD Charge_2_V1_FreeCharge_CM_uint32 "Q = V" RAT_FUNC "%10.0" "" COEFFS 0 1 0 0 0 1 /end COMPU_METHOD
/begin COMPU_METHOD Charge_2_V1_FreeCharge_CM_uint16 "Q = V" RAT_FUNC "%5.0" "" COEFFS 0 1 0 0 0 1 /end COMPU_METHOD
/begin COMPU_METHOD Charge_2_V1_FreeCharge_CM_uint8 "Q = V" RAT_FUNC "%3.0" "" COEFFS 0 1 0 0 0 1 /end COMPU_METHOD
/begin COMPU_METHOD Charge_2_V1_FreeCharge_CM_int8 "Q = V" RAT_FUNC "%3.0" "" COEFFS 0 1 0 0 0 1 /end COMPU_METHOD
/begin GROUP Charge_2_V1_FreeCharge "Charge_2_V1_FreeCharge" /* Root */ ROOT /begin SUB_GROUP Root_HANcoder_STM32_Target___E407_STM32_algorithm /end SUB_GROUP /end GROUP
/begin GROUP Root_HANcoder_STM32_Target___E407_STM32_algorithm "Charge_2_V1_FreeCharge/HANcoder STM32 Target - E407-STM32 algorithm"
 /begin SUB_GROUP S1_Authorized_card S1_Car1 S1_Car2 S1_Config S1_Current_SP S1_Energy_Meter1 S1_Partclie_SP_Receive S1_Subsystem /end SUB_GROUP
/end GROUP
/begin GROUP S1_Authorized_card "Charge_2_V1_FreeCharge/HANcoder STM32 Target - E407-STM32 algorithm/Authorized card" /begin SUB_GROUP S2_Digital_Input2 /end SUB_GROUP /begin REF_CHARACTERISTIC Free_Charge /end REF_CHARACTERISTIC /begin REF_MEASUREMENT Enable_card1 Enable_card2 /end REF_MEASUREMENT /end GROUP
/begin GROUP S1_Car1 "Charge_2_V1_FreeCharge/HANcoder STM32 Target - E407-STM32 algorithm/Car1" /begin SUB_GROUP S3_Output_leds S3_Pilotcar1 S3_delaytime /end SUB_GROUP /begin REF_MEASUREMENT Car1State Current_Input_car1 LockCar1On /end REF_MEASUREMENT /end GROUP
/begin GROUP S1_Car2 "Charge_2_V1_FreeCharge/HANcoder STM32 Target - E407-STM32 algorithm/Car2" /begin SUB_GROUP S4_Pilotcar2 S4_delaytime /end SUB_GROUP /begin REF_MEASUREMENT Car2State Current_input_car2 LockCar2On /end REF_MEASUREMENT /end GROUP
/begin GROUP S1_Config "Charge_2_V1_FreeCharge/HANcoder STM32 Target - E407-STM32 algorithm/Config" /begin SUB_GROUP S5_System_information /end SUB_GROUP /end GROUP
/begin GROUP S1_Current_SP "Charge_2_V1_FreeCharge/HANcoder STM32 Target - E407-STM32 algorithm/Current_SP" /begin SUB_GROUP S7_Current_Limit1 S7_Subsystem1 S7_Subsystem2 /end SUB_GROUP /begin REF_CHARACTERISTIC Control_Mode_In Voltage_Mode_Test /end REF_CHARACTERISTIC /begin REF_MEASUREMENT Mode /end REF_MEASUREMENT /end GROUP
/begin GROUP S1_Energy_Meter1 "Charge_2_V1_FreeCharge/HANcoder STM32 Target - E407-STM32 algorithm/Energy Meter1" /begin SUB_GROUP S8_Energy_Meter_Recieve S8_Energymeter_Request S8_Particle /end SUB_GROUP /end GROUP
/begin GROUP S1_Partclie_SP_Receive "Charge_2_V1_FreeCharge/HANcoder STM32 Target - E407-STM32 algorithm/Partclie_SP_Receive" /begin SUB_GROUP S9_SP1 /end SUB_GROUP /end GROUP
/begin GROUP S1_Subsystem "Charge_2_V1_FreeCharge/HANcoder STM32 Target - E407-STM32 algorithm/Subsystem"
 /begin REF_CHARACTERISTIC Car1__Authorize Car2_Authorize SeconCar_ThreePhase V_Current_five V_Current_four V_Current_one V_Current_six V_Current_three V_Current_two V_Frequency V_MaxPliot V_MinPliot /end REF_CHARACTERISTIC
 /begin REF_MEASUREMENT V_Frequency_SP /end REF_MEASUREMENT
/end GROUP
/begin GROUP S2_Digital_Input2 "Charge_2_V1_FreeCharge/HANcoder STM32 Target - E407-STM32 algorithm/Authorized card/Digital Input2" /begin REF_MEASUREMENT RFID_Read /end REF_MEASUREMENT /end GROUP
/begin GROUP S3_Output_leds "Charge_2_V1_FreeCharge/HANcoder STM32 Target - E407-STM32 algorithm/Car1/Output leds" /begin REF_MEASUREMENT State_Test State_Test_1 State_Test_2 /end REF_MEASUREMENT /end GROUP
/begin GROUP S3_Pilotcar1 "Charge_2_V1_FreeCharge/HANcoder STM32 Target - E407-STM32 algorithm/Car1/Pilotcar1" /begin SUB_GROUP S18_Analog_Input /end SUB_GROUP /begin REF_MEASUREMENT Max_Pilot Min_Pilot /end REF_MEASUREMENT /end GROUP
/begin GROUP S3_delaytime "Charge_2_V1_FreeCharge/HANcoder STM32 Target - E407-STM32 algorithm/Car1/delaytime" /begin SUB_GROUP S19_Off_Delay S19_On_Delay /end SUB_GROUP /end GROUP
/begin GROUP S4_Pilotcar2 "Charge_2_V1_FreeCharge/HANcoder STM32 Target - E407-STM32 algorithm/Car2/Pilotcar2" /begin SUB_GROUP S80_Analog_Input /end SUB_GROUP /begin REF_MEASUREMENT Max_out Maxpilotcar2 Minpilotcar2 /end REF_MEASUREMENT /end GROUP
/begin GROUP S4_delaytime "Charge_2_V1_FreeCharge/HANcoder STM32 Target - E407-STM32 algorithm/Car2/delaytime" /begin SUB_GROUP S81_Off_Delay S81_On_Delay /end SUB_GROUP /end GROUP
/begin GROUP S5_System_information "Charge_2_V1_FreeCharge/HANcoder STM32 Target - E407-STM32 algorithm/Config/System information" /begin SUB_GROUP S141_Get_CPU_load S141_Get_free_Heap S141_Get_free_Stack /end SUB_GROUP /end GROUP
/begin GROUP S7_Current_Limit1 "Charge_2_V1_FreeCharge/HANcoder STM32 Target - E407-STM32 algorithm/Current_SP/Current_Limit1" /begin REF_MEASUREMENT Current_Limit Current_Limit_state /end REF_MEASUREMENT /end GROUP
/begin GROUP S7_Subsystem1 "Charge_2_V1_FreeCharge/HANcoder STM32 Target - E407-STM32 algorithm/Current_SP/Subsystem1"
 /begin SUB_GROUP S149_Car_type_detection S149_Fre_Control S149_Voltage_Control /end SUB_GROUP
 /begin REF_CHARACTERISTIC CurrentSP /end REF_CHARACTERISTIC
 /begin REF_MEASUREMENT Current_SP_Car1 Initial_Current_1 Power_SP /end REF_MEASUREMENT
/end GROUP
/begin GROUP S7_Subsystem2 "Charge_2_V1_FreeCharge/HANcoder STM32 Target - E407-STM32 algorithm/Current_SP/Subsystem2"
 /begin SUB_GROUP S150_Car_type_detection S150_Frquency_Control S150_Voltage_Control /end SUB_GROUP
 /begin REF_CHARACTERISTIC CurrentSP /end REF_CHARACTERISTIC
 /begin REF_MEASUREMENT Control_Mode_Out Current_SP_car2 Initial_current_2 /end REF_MEASUREMENT
/end GROUP
/begin GROUP S8_Energy_Meter_Recieve "Charge_2_V1_FreeCharge/HANcoder STM32 Target - E407-STM32 algorithm/Energy Meter1/Energy_Meter_Recieve"
 /begin SUB_GROUP S292_CurrentMeter2 S292_Current_Meter S292_Fequency S292_Subsystem S292_Subsystem5 S292_Voltage_Meter_1 S292_Voltage_Meter_2 /end SUB_GROUP
/end GROUP
/begin GROUP S8_Energymeter_Request "Charge_2_V1_FreeCharge/HANcoder STM32 Target - E407-STM32 algorithm/Energy Meter1/Energymeter_Request" /begin SUB_GROUP S293_Current_Meter_1_ S293_RequestMessages_Enable_ /end SUB_GROUP /end GROUP
/begin GROUP S8_Particle "Charge_2_V1_FreeCharge/HANcoder STM32 Target - E407-STM32 algorithm/Energy Meter1/Particle" /begin SUB_GROUP S294_UART_receive_buffer_status /end SUB_GROUP /end GROUP
/begin GROUP S9_SP1 "Charge_2_V1_FreeCharge/HANcoder STM32 Target - E407-STM32 algorithm/Partclie_SP_Receive/SP1"
 /begin SUB_GROUP S957_Read_Gyro S957_Read_Gyro1 S957_Read_Gyro2 S957_Read_Gyro3 S957_Subsystem /end SUB_GROUP
/end GROUP
/begin GROUP S18_Analog_Input "Charge_2_V1_FreeCharge/HANcoder STM32 Target - E407-STM32 algorithm/Car1/Pilotcar1/Analog Input" /begin REF_MEASUREMENT PilotCar1Raw /end REF_MEASUREMENT /end GROUP
/begin GROUP S19_Off_Delay "Charge_2_V1_FreeCharge/HANcoder STM32 Target - E407-STM32 algorithm/Car1/delaytime/Off Delay" /begin SUB_GROUP S52_Model /end SUB_GROUP /end GROUP
/begin GROUP S19_On_Delay "Charge_2_V1_FreeCharge/HANcoder STM32 Target - E407-STM32 algorithm/Car1/delaytime/On Delay" /begin SUB_GROUP S53_Model /end SUB_GROUP /end GROUP
/begin GROUP S80_Analog_Input "Charge_2_V1_FreeCharge/HANcoder STM32 Target - E407-STM32 algorithm/Car2/Pilotcar2/Analog Input" /begin REF_MEASUREMENT PilotCar2Raw /end REF_MEASUREMENT /end GROUP
/begin GROUP S81_Off_Delay "Charge_2_V1_FreeCharge/HANcoder STM32 Target - E407-STM32 algorithm/Car2/delaytime/Off Delay" /begin SUB_GROUP S114_Model /end SUB_GROUP /end GROUP
/begin GROUP S81_On_Delay "Charge_2_V1_FreeCharge/HANcoder STM32 Target - E407-STM32 algorithm/Car2/delaytime/On Delay" /begin SUB_GROUP S115_Model /end SUB_GROUP /end GROUP
/begin GROUP S141_Get_CPU_load "Charge_2_V1_FreeCharge/HANcoder STM32 Target - E407-STM32 algorithm/Config/System information/Get CPU load" /begin REF_MEASUREMENT SI_CPUload /end REF_MEASUREMENT /end GROUP
/begin GROUP S141_Get_free_Heap "Charge_2_V1_FreeCharge/HANcoder STM32 Target - E407-STM32 algorithm/Config/System information/Get free Heap" /begin REF_MEASUREMENT SI_FreeHeap /end REF_MEASUREMENT /end GROUP
/begin GROUP S141_Get_free_Stack "Charge_2_V1_FreeCharge/HANcoder STM32 Target - E407-STM32 algorithm/Config/System information/Get free Stack" /begin REF_MEASUREMENT SI_FreeStack /end REF_MEASUREMENT /end GROUP
/begin GROUP S149_Car_type_detection "Charge_2_V1_FreeCharge/HANcoder STM32 Target - E407-STM32 algorithm/Current_SP/Subsystem1/Car_type_detection" /begin REF_MEASUREMENT Car_type_charge1 /end REF_MEASUREMENT /end GROUP
/begin GROUP S149_Fre_Control "Charge_2_V1_FreeCharge/HANcoder STM32 Target - E407-STM32 algorithm/Current_SP/Subsystem1/Fre_Control" /begin SUB_GROUP S162_16A_Car S162_32A_Car1 S162_Subsystem1 /end SUB_GROUP /end GROUP
/begin GROUP S149_Voltage_Control "Charge_2_V1_FreeCharge/HANcoder STM32 Target - E407-STM32 algorithm/Current_SP/Subsystem1/Voltage_Control" /begin SUB_GROUP S165_1phase S165_3phase /end SUB_GROUP /end GROUP
/begin GROUP S150_Car_type_detection "Charge_2_V1_FreeCharge/HANcoder STM32 Target - E407-STM32 algorithm/Current_SP/Subsystem2/Car_type_detection" /begin REF_MEASUREMENT Car_type_charge2 /end REF_MEASUREMENT /end GROUP
/begin GROUP S150_Frquency_Control "Charge_2_V1_FreeCharge/HANcoder STM32 Target - E407-STM32 algorithm/Current_SP/Subsystem2/Frquency_Control" /begin SUB_GROUP S215_16A_Car S215_32A_Car S215_Subsystem /end SUB_GROUP /end GROUP
/begin GROUP S150_Voltage_Control "Charge_2_V1_FreeCharge/HANcoder STM32 Target - E407-STM32 algorithm/Current_SP/Subsystem2/Voltage_Control" /begin SUB_GROUP S218_1phase S218_3phase /end SUB_GROUP /begin REF_MEASUREMENT voltage_de /end REF_MEASUREMENT /end GROUP
/begin GROUP S292_CurrentMeter2 "Charge_2_V1_FreeCharge/HANcoder STM32 Target - E407-STM32 algorithm/Energy Meter1/Energy_Meter_Recieve/CurrentMeter2" /begin SUB_GROUP S299_Read_Gyro1 /end SUB_GROUP /end GROUP
/begin GROUP S292_Current_Meter "Charge_2_V1_FreeCharge/HANcoder STM32 Target - E407-STM32 algorithm/Energy Meter1/Energy_Meter_Recieve/Current_Meter" /begin SUB_GROUP S300_Read_Gyro1 /end SUB_GROUP /end GROUP
/begin GROUP S292_Fequency "Charge_2_V1_FreeCharge/HANcoder STM32 Target - E407-STM32 algorithm/Energy Meter1/Energy_Meter_Recieve/Fequency" /begin SUB_GROUP S301_Read_Gyro1 /end SUB_GROUP /end GROUP
/begin GROUP S292_Subsystem "Charge_2_V1_FreeCharge/HANcoder STM32 Target - E407-STM32 algorithm/Energy Meter1/Energy_Meter_Recieve/Subsystem"
 /begin SUB_GROUP S302_FloatConv1 S302_FloatConv2 S302_FloatConv3 S302_FloatConv4 S302_FloatConv5 S302_FloatConv6 S302_FloatConv7 /end SUB_GROUP
/end GROUP
/begin GROUP S292_Subsystem5 "Charge_2_V1_FreeCharge/HANcoder STM32 Target - E407-STM32 algorithm/Energy Meter1/Energy_Meter_Recieve/Subsystem5"
 /begin SUB_GROUP S306_FloatConv2 S306_FloatConv3 S306_FloatConv4 S306_FloatConv5 S306_FloatConv6 S306_FloatConv7 /end SUB_GROUP
/end GROUP
/begin GROUP S292_Voltage_Meter_1 "Charge_2_V1_FreeCharge/HANcoder STM32 Target - E407-STM32 algorithm/Energy Meter1/Energy_Meter_Recieve/Voltage_Meter_1" /begin SUB_GROUP S307_Read_Gyro1 /end SUB_GROUP /end GROUP
/begin GROUP S292_Voltage_Meter_2 "Charge_2_V1_FreeCharge/HANcoder STM32 Target - E407-STM32 algorithm/Energy Meter1/Energy_Meter_Recieve/Voltage_Meter_2" /begin SUB_GROUP S308_Read_Gyro1 /end SUB_GROUP /end GROUP
/begin GROUP S293_Current_Meter_1_ "Charge_2_V1_FreeCharge/HANcoder STM32 Target - E407-STM32 algorithm/Energy Meter1/Energymeter_Request/Current_Meter_1 " /begin SUB_GROUP S811_Read_Gyro1 /end SUB_GROUP /begin REF_MEASUREMENT counter /end REF_MEASUREMENT /end GROUP
/begin GROUP S293_RequestMessages_Enable_ "Charge_2_V1_FreeCharge/HANcoder STM32 Target - E407-STM32 algorithm/Energy Meter1/Energymeter_Request/RequestMessages_Enable " /begin REF_MEASUREMENT enable /end REF_MEASUREMENT /end GROUP
/begin GROUP S294_UART_receive_buffer_status "Charge_2_V1_FreeCharge/HANcoder STM32 Target - E407-STM32 algorithm/Energy Meter1/Particle/UART receive buffer status" /begin REF_MEASUREMENT Status /end REF_MEASUREMENT /end GROUP
/begin GROUP S957_Read_Gyro "Charge_2_V1_FreeCharge/HANcoder STM32 Target - E407-STM32 algorithm/Partclie_SP_Receive/SP1/Read_Gyro" /begin SUB_GROUP S967_UART_receive /end SUB_GROUP /end GROUP
/begin GROUP S957_Read_Gyro1 "Charge_2_V1_FreeCharge/HANcoder STM32 Target - E407-STM32 algorithm/Partclie_SP_Receive/SP1/Read_Gyro1" /begin SUB_GROUP S968_UART_receive /end SUB_GROUP /end GROUP
/begin GROUP S957_Read_Gyro2 "Charge_2_V1_FreeCharge/HANcoder STM32 Target - E407-STM32 algorithm/Partclie_SP_Receive/SP1/Read_Gyro2" /begin SUB_GROUP S969_UART_receive /end SUB_GROUP /end GROUP
/begin GROUP S957_Read_Gyro3 "Charge_2_V1_FreeCharge/HANcoder STM32 Target - E407-STM32 algorithm/Partclie_SP_Receive/SP1/Read_Gyro3" /begin SUB_GROUP S970_UART_receive /end SUB_GROUP /end GROUP
/begin GROUP S957_Subsystem "Charge_2_V1_FreeCharge/HANcoder STM32 Target - E407-STM32 algorithm/Partclie_SP_Receive/SP1/Subsystem" /begin REF_MEASUREMENT SP1_P SP2_P /end REF_MEASUREMENT /end GROUP
/begin GROUP S52_Model "Charge_2_V1_FreeCharge/HANcoder STM32 Target - E407-STM32 algorithm/Car1/delaytime/Off Delay/Model" /begin REF_MEASUREMENT LockCar1off /end REF_MEASUREMENT /end GROUP
/begin GROUP S53_Model "Charge_2_V1_FreeCharge/HANcoder STM32 Target - E407-STM32 algorithm/Car1/delaytime/On Delay/Model" /begin REF_MEASUREMENT SwitchCar1 /end REF_MEASUREMENT /end GROUP
/begin GROUP S114_Model "Charge_2_V1_FreeCharge/HANcoder STM32 Target - E407-STM32 algorithm/Car2/delaytime/Off Delay/Model" /begin REF_MEASUREMENT LockCar2off /end REF_MEASUREMENT /end GROUP
/begin GROUP S115_Model "Charge_2_V1_FreeCharge/HANcoder STM32 Target - E407-STM32 algorithm/Car2/delaytime/On Delay/Model" /begin REF_MEASUREMENT SwitchCar2 /end REF_MEASUREMENT /end GROUP
/begin GROUP S162_16A_Car "Charge_2_V1_FreeCharge/HANcoder STM32 Target - E407-STM32 algorithm/Current_SP/Subsystem1/Fre_Control/16A_Car" /begin REF_CHARACTERISTIC Frequency_Low_Point Frequency_Mid_high /end REF_CHARACTERISTIC /end GROUP
/begin GROUP S162_32A_Car1 "Charge_2_V1_FreeCharge/HANcoder STM32 Target - E407-STM32 algorithm/Current_SP/Subsystem1/Fre_Control/32A_Car1" /begin REF_CHARACTERISTIC Frequency_Low_Point Frequency_Mid_high /end REF_CHARACTERISTIC /end GROUP
/begin GROUP S162_Subsystem1 "Charge_2_V1_FreeCharge/HANcoder STM32 Target - E407-STM32 algorithm/Current_SP/Subsystem1/Fre_Control/Subsystem1"
 /begin REF_CHARACTERISTIC Frequency_High_Point Frequency_Low_Point Frequency_Mid_high Frequency_Mid_low /end REF_CHARACTERISTIC
/end GROUP
/begin GROUP S165_1phase "Charge_2_V1_FreeCharge/HANcoder STM32 Target - E407-STM32 algorithm/Current_SP/Subsystem1/Voltage_Control/1phase" /begin SUB_GROUP S185_16A S185_32Acar S185_Subsystem /end SUB_GROUP /end GROUP
/begin GROUP S165_3phase "Charge_2_V1_FreeCharge/HANcoder STM32 Target - E407-STM32 algorithm/Current_SP/Subsystem1/Voltage_Control/3phase" /begin SUB_GROUP S186_16A S186_32Acar S186_Subsystem1 /end SUB_GROUP /end GROUP
/begin GROUP S215_16A_Car "Charge_2_V1_FreeCharge/HANcoder STM32 Target - E407-STM32 algorithm/Current_SP/Subsystem2/Frquency_Control/16A_Car" /begin REF_CHARACTERISTIC Frequency_Low_Point Frequency_Mid_high /end REF_CHARACTERISTIC /end GROUP
/begin GROUP S215_32A_Car "Charge_2_V1_FreeCharge/HANcoder STM32 Target - E407-STM32 algorithm/Current_SP/Subsystem2/Frquency_Control/32A_Car" /begin REF_CHARACTERISTIC Frequency_Low_Point Frequency_Mid_high /end REF_CHARACTERISTIC /end GROUP
/begin GROUP S215_Subsystem "Charge_2_V1_FreeCharge/HANcoder STM32 Target - E407-STM32 algorithm/Current_SP/Subsystem2/Frquency_Control/Subsystem"
 /begin REF_CHARACTERISTIC Frequency_High_Point Frequency_Low_Point Frequency_Mid_high Frequency_Mid_low /end REF_CHARACTERISTIC
/end GROUP
/begin GROUP S218_1phase "Charge_2_V1_FreeCharge/HANcoder STM32 Target - E407-STM32 algorithm/Current_SP/Subsystem2/Voltage_Control/1phase" /begin SUB_GROUP S238_16A S238_32Acar S238_Subsystem /end SUB_GROUP /begin REF_MEASUREMENT VoltageControl1phaseout /end REF_MEASUREMENT /end GROUP
/begin GROUP S218_3phase "Charge_2_V1_FreeCharge/HANcoder STM32 Target - E407-STM32 algorithm/Current_SP/Subsystem2/Voltage_Control/3phase" /begin SUB_GROUP S239_16A S239_32Acar S239_Subsystem1 /end SUB_GROUP /end GROUP
/begin GROUP S299_Read_Gyro1 "Charge_2_V1_FreeCharge/HANcoder STM32 Target - E407-STM32 algorithm/Energy Meter1/Energy_Meter_Recieve/CurrentMeter2/Read_Gyro1" /begin SUB_GROUP S329_UART_receive /end SUB_GROUP /end GROUP
/begin GROUP S300_Read_Gyro1 "Charge_2_V1_FreeCharge/HANcoder STM32 Target - E407-STM32 algorithm/Energy Meter1/Energy_Meter_Recieve/Current_Meter/Read_Gyro1" /begin SUB_GROUP S386_UART_receive /end SUB_GROUP /end GROUP
/begin GROUP S301_Read_Gyro1 "Charge_2_V1_FreeCharge/HANcoder STM32 Target - E407-STM32 algorithm/Energy Meter1/Energy_Meter_Recieve/Fequency/Read_Gyro1" /begin SUB_GROUP S435_UART_receive /end SUB_GROUP /end GROUP
/begin GROUP S302_FloatConv1 "Charge_2_V1_FreeCharge/HANcoder STM32 Target - E407-STM32 algorithm/Energy Meter1/Energy_Meter_Recieve/Subsystem/FloatConv1" /begin REF_MEASUREMENT Frequency /end REF_MEASUREMENT /end GROUP
/begin GROUP S302_FloatConv2 "Charge_2_V1_FreeCharge/HANcoder STM32 Target - E407-STM32 algorithm/Energy Meter1/Energy_Meter_Recieve/Subsystem/FloatConv2" /begin REF_MEASUREMENT Current_phase6 /end REF_MEASUREMENT /end GROUP
/begin GROUP S302_FloatConv3 "Charge_2_V1_FreeCharge/HANcoder STM32 Target - E407-STM32 algorithm/Energy Meter1/Energy_Meter_Recieve/Subsystem/FloatConv3" /begin REF_MEASUREMENT Current_phase5 /end REF_MEASUREMENT /end GROUP
/begin GROUP S302_FloatConv4 "Charge_2_V1_FreeCharge/HANcoder STM32 Target - E407-STM32 algorithm/Energy Meter1/Energy_Meter_Recieve/Subsystem/FloatConv4" /begin REF_MEASUREMENT Current_phase4 /end REF_MEASUREMENT /end GROUP
/begin GROUP S302_FloatConv5 "Charge_2_V1_FreeCharge/HANcoder STM32 Target - E407-STM32 algorithm/Energy Meter1/Energy_Meter_Recieve/Subsystem/FloatConv5" /begin REF_MEASUREMENT Current_phase3 /end REF_MEASUREMENT /end GROUP
/begin GROUP S302_FloatConv6 "Charge_2_V1_FreeCharge/HANcoder STM32 Target - E407-STM32 algorithm/Energy Meter1/Energy_Meter_Recieve/Subsystem/FloatConv6" /begin REF_MEASUREMENT Current_phase2 /end REF_MEASUREMENT /end GROUP
/begin GROUP S302_FloatConv7 "Charge_2_V1_FreeCharge/HANcoder STM32 Target - E407-STM32 algorithm/Energy Meter1/Energy_Meter_Recieve/Subsystem/FloatConv7" /begin REF_MEASUREMENT Current_phase1 /end REF_MEASUREMENT /end GROUP
/begin GROUP S306_FloatConv2 "Charge_2_V1_FreeCharge/HANcoder STM32 Target - E407-STM32 algorithm/Energy Meter1/Energy_Meter_Recieve/Subsystem5/FloatConv2" /begin REF_MEASUREMENT Voltage_phase6 /end REF_MEASUREMENT /end GROUP
/begin GROUP S306_FloatConv3 "Charge_2_V1_FreeCharge/HANcoder STM32 Target - E407-STM32 algorithm/Energy Meter1/Energy_Meter_Recieve/Subsystem5/FloatConv3" /begin REF_MEASUREMENT Voltage_phase5 /end REF_MEASUREMENT /end GROUP
/begin GROUP S306_FloatConv4 "Charge_2_V1_FreeCharge/HANcoder STM32 Target - E407-STM32 algorithm/Energy Meter1/Energy_Meter_Recieve/Subsystem5/FloatConv4" /begin REF_MEASUREMENT Voltage_phase4 /end REF_MEASUREMENT /end GROUP
/begin GROUP S306_FloatConv5 "Charge_2_V1_FreeCharge/HANcoder STM32 Target - E407-STM32 algorithm/Energy Meter1/Energy_Meter_Recieve/Subsystem5/FloatConv5" /begin REF_MEASUREMENT Voltage_phase3 /end REF_MEASUREMENT /end GROUP
/begin GROUP S306_FloatConv6 "Charge_2_V1_FreeCharge/HANcoder STM32 Target - E407-STM32 algorithm/Energy Meter1/Energy_Meter_Recieve/Subsystem5/FloatConv6" /begin REF_MEASUREMENT Voltage_phase2 /end REF_MEASUREMENT /end GROUP
/begin GROUP S306_FloatConv7 "Charge_2_V1_FreeCharge/HANcoder STM32 Target - E407-STM32 algorithm/Energy Meter1/Energy_Meter_Recieve/Subsystem5/FloatConv7" /begin REF_MEASUREMENT Voltage_phase1 /end REF_MEASUREMENT /end GROUP
/begin GROUP S307_Read_Gyro1 "Charge_2_V1_FreeCharge/HANcoder STM32 Target - E407-STM32 algorithm/Energy Meter1/Energy_Meter_Recieve/Voltage_Meter_1/Read_Gyro1" /begin SUB_GROUP S716_UART_receive /end SUB_GROUP /end GROUP
/begin GROUP S308_Read_Gyro1 "Charge_2_V1_FreeCharge/HANcoder STM32 Target - E407-STM32 algorithm/Energy Meter1/Energy_Meter_Recieve/Voltage_Meter_2/Read_Gyro1" /begin SUB_GROUP S773_UART_receive /end SUB_GROUP /end GROUP
/begin GROUP S811_Read_Gyro1 "Charge_2_V1_FreeCharge/HANcoder STM32 Target - E407-STM32 algorithm/Energy Meter1/Energymeter_Request/Current_Meter_1 /Read_Gyro1" /begin REF_MEASUREMENT Sent_to_MCU /end REF_MEASUREMENT /end GROUP
/begin GROUP S967_UART_receive "Charge_2_V1_FreeCharge/HANcoder STM32 Target - E407-STM32 algorithm/Partclie_SP_Receive/SP1/Read_Gyro/UART receive" /begin REF_MEASUREMENT Setpoin_check1 /end REF_MEASUREMENT /end GROUP
/begin GROUP S968_UART_receive "Charge_2_V1_FreeCharge/HANcoder STM32 Target - E407-STM32 algorithm/Partclie_SP_Receive/SP1/Read_Gyro1/UART receive" /begin REF_MEASUREMENT SP_ID /end REF_MEASUREMENT /end GROUP
/begin GROUP S969_UART_receive "Charge_2_V1_FreeCharge/HANcoder STM32 Target - E407-STM32 algorithm/Partclie_SP_Receive/SP1/Read_Gyro2/UART receive" /begin REF_MEASUREMENT Setpoint1 /end REF_MEASUREMENT /end GROUP
/begin GROUP S970_UART_receive "Charge_2_V1_FreeCharge/HANcoder STM32 Target - E407-STM32 algorithm/Partclie_SP_Receive/SP1/Read_Gyro3/UART receive" /begin REF_MEASUREMENT End_SP1 /end REF_MEASUREMENT /end GROUP
/begin GROUP S185_16A "Charge_2_V1_FreeCharge/HANcoder STM32 Target - E407-STM32 algorithm/Current_SP/Subsystem1/Voltage_Control/1phase/16A" /begin REF_CHARACTERISTIC Vol_Low_Point Vol_Mid_high Voltage_Factor /end REF_CHARACTERISTIC /end GROUP
/begin GROUP S185_32Acar "Charge_2_V1_FreeCharge/HANcoder STM32 Target - E407-STM32 algorithm/Current_SP/Subsystem1/Voltage_Control/1phase/32Acar" /begin REF_CHARACTERISTIC Vol_Low_Point Vol_Mid_high Voltage_Factor /end REF_CHARACTERISTIC /end GROUP
/begin GROUP S185_Subsystem "Charge_2_V1_FreeCharge/HANcoder STM32 Target - E407-STM32 algorithm/Current_SP/Subsystem1/Voltage_Control/1phase/Subsystem" /begin REF_CHARACTERISTIC Vol_High_Point Vol_Low_Point Vol_Mid_high Vol_Mid_low /end REF_CHARACTERISTIC /end GROUP
/begin GROUP S186_16A "Charge_2_V1_FreeCharge/HANcoder STM32 Target - E407-STM32 algorithm/Current_SP/Subsystem1/Voltage_Control/3phase/16A" /begin REF_CHARACTERISTIC HVol_Low_Point HVol_Mid_high HVoltage_Factor /end REF_CHARACTERISTIC /end GROUP
/begin GROUP S186_32Acar "Charge_2_V1_FreeCharge/HANcoder STM32 Target - E407-STM32 algorithm/Current_SP/Subsystem1/Voltage_Control/3phase/32Acar" /begin REF_CHARACTERISTIC HVol_Low_Point HVol_Mid_high HVoltage_Factor /end REF_CHARACTERISTIC /end GROUP
/begin GROUP S186_Subsystem1 "Charge_2_V1_FreeCharge/HANcoder STM32 Target - E407-STM32 algorithm/Current_SP/Subsystem1/Voltage_Control/3phase/Subsystem1" /begin REF_CHARACTERISTIC HVol_High_Point HVol_Low_Point HVol_Mid_high HVol_Mid_low /end REF_CHARACTERISTIC /end GROUP
/begin GROUP S238_16A "Charge_2_V1_FreeCharge/HANcoder STM32 Target - E407-STM32 algorithm/Current_SP/Subsystem2/Voltage_Control/1phase/16A" /begin REF_CHARACTERISTIC Vol_Low_Point Vol_Mid_high Voltage_Factor /end REF_CHARACTERISTIC /end GROUP
/begin GROUP S238_32Acar "Charge_2_V1_FreeCharge/HANcoder STM32 Target - E407-STM32 algorithm/Current_SP/Subsystem2/Voltage_Control/1phase/32Acar" /begin REF_CHARACTERISTIC Vol_Low_Point Vol_Mid_high Voltage_Factor /end REF_CHARACTERISTIC /end GROUP
/begin GROUP S238_Subsystem "Charge_2_V1_FreeCharge/HANcoder STM32 Target - E407-STM32 algorithm/Current_SP/Subsystem2/Voltage_Control/1phase/Subsystem" /begin REF_CHARACTERISTIC Vol_High_Point Vol_Low_Point Vol_Mid_high Vol_Mid_low /end REF_CHARACTERISTIC /end GROUP
/begin GROUP S239_16A "Charge_2_V1_FreeCharge/HANcoder STM32 Target - E407-STM32 algorithm/Current_SP/Subsystem2/Voltage_Control/3phase/16A" /begin REF_CHARACTERISTIC HVol_Low_Point HVol_Mid_high HVoltage_Factor /end REF_CHARACTERISTIC /end GROUP
/begin GROUP S239_32Acar "Charge_2_V1_FreeCharge/HANcoder STM32 Target - E407-STM32 algorithm/Current_SP/Subsystem2/Voltage_Control/3phase/32Acar" /begin REF_CHARACTERISTIC HVol_Low_Point HVol_Mid_high HVoltage_Factor /end REF_CHARACTERISTIC /end GROUP
/begin GROUP S239_Subsystem1 "Charge_2_V1_FreeCharge/HANcoder STM32 Target - E407-STM32 algorithm/Current_SP/Subsystem2/Voltage_Control/3phase/Subsystem1" /begin REF_CHARACTERISTIC HVol_High_Point HVol_Low_Point HVol_Mid_high HVol_Mid_low /end REF_CHARACTERISTIC /begin REF_MEASUREMENT VoltageControl3phaseout /end REF_MEASUREMENT /end GROUP
/begin GROUP S329_UART_receive "Charge_2_V1_FreeCharge/HANcoder STM32 Target - E407-STM32 algorithm/Energy Meter1/Energy_Meter_Recieve/CurrentMeter2/Read_Gyro1/UART receive" /begin REF_MEASUREMENT Check_ID2_Current2 /end REF_MEASUREMENT /end GROUP
/begin GROUP S386_UART_receive "Charge_2_V1_FreeCharge/HANcoder STM32 Target - E407-STM32 algorithm/Energy Meter1/Energy_Meter_Recieve/Current_Meter/Read_Gyro1/UART receive" /begin REF_MEASUREMENT Check_ID_Current1 /end REF_MEASUREMENT /end GROUP
/begin GROUP S435_UART_receive "Charge_2_V1_FreeCharge/HANcoder STM32 Target - E407-STM32 algorithm/Energy Meter1/Energy_Meter_Recieve/Fequency/Read_Gyro1/UART receive" /begin REF_MEASUREMENT Check_Fre_ID /end REF_MEASUREMENT /end GROUP
/begin GROUP S716_UART_receive "Charge_2_V1_FreeCharge/HANcoder STM32 Target - E407-STM32 algorithm/Energy Meter1/Energy_Meter_Recieve/Voltage_Meter_1/Read_Gyro1/UART receive" /begin REF_MEASUREMENT Check_ID_Voltage1 /end REF_MEASUREMENT /end GROUP
/begin GROUP S773_UART_receive "Charge_2_V1_FreeCharge/HANcoder STM32 Target - E407-STM32 algorithm/Energy Meter1/Energy_Meter_Recieve/Voltage_Meter_2/Read_Gyro1/UART receive" /begin REF_MEASUREMENT Check_ID_Voltage2 /end REF_MEASUREMENT /end GROUP
/end MODULE
/end PROJECT
/* (add any file trailer comments here) */
/* EOF Charge_2_V1_FreeCharge.a2l */
